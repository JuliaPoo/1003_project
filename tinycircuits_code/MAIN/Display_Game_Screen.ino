#define ALPHA 0xFE
#define BACKGROUND 0xE5
#define GROUND 0x1C

#define Rx 96
#define Ry 64
unsigned char LINEBUFFER[Rx];

//#########################
//###### SPRITE DATA ######
//#########################
// Not enough space to add my kitties :(

const unsigned char HAMBURGER_MENU_XY[2] PROGMEM = {8, 6};
const unsigned char HAMBURGER_MENU[8*6] PROGMEM = {255, 255, 255, 255, 255, 255, 255, 255, ALPHA, ALPHA, ALPHA, ALPHA, ALPHA, ALPHA, ALPHA, ALPHA, 255, 255, 255, 255, 255, 255, 255, 255, 255, 255, 255, 255, 255, 255, 255, 255, ALPHA, ALPHA, ALPHA, ALPHA, ALPHA, ALPHA, ALPHA, ALPHA, 255, 255, 255, 255, 255, 255, 255, 255};

const char RUN_disp[16] PROGMEM = {0, 0, 1, -1, 4, -1, 3, -1, 0, 0, 1, -1, 4, -1, 3, -1};
const char RUN_disp2[8] PROGMEM = {4, 4, 4, 4, 4, 4, 3, 3};
const unsigned char RUN_XY[16] PROGMEM = {15, 19, 14, 20, 11, 19, 12, 19, 15, 19, 14, 20, 12, 19, 13, 19};
const unsigned char RUN_0[285] PROGMEM = {ALPHA, ALPHA, ALPHA, ALPHA, ALPHA, ALPHA, ALPHA, ALPHA, ALPHA, ALPHA, 223, 223, 223, ALPHA, ALPHA, ALPHA, ALPHA, ALPHA, ALPHA, ALPHA, ALPHA, ALPHA, ALPHA, 223, 223, 223, 2, 1, 1, ALPHA, ALPHA, ALPHA, ALPHA, ALPHA, ALPHA, ALPHA, ALPHA, ALPHA, 223, 223, 2, 1, 1, 1, 1, ALPHA, ALPHA, ALPHA, ALPHA, ALPHA, ALPHA, ALPHA, 223, 223, 223, 2, 146, 32, 1, 146, ALPHA, ALPHA, ALPHA, ALPHA, ALPHA, ALPHA, 146, 223, 223, 223, 2, 223, 32, 51, 32, ALPHA, ALPHA, ALPHA, ALPHA, ALPHA, ALPHA, 146, 146, 146, 146, 146, 1, 51, 32, 32, ALPHA, ALPHA, ALPHA, ALPHA, ALPHA, ALPHA, 146, 146, 146, 146, 146, 1, 1, 32, 146, ALPHA, ALPHA, ALPHA, ALPHA, ALPHA, 2, 155, 223, 223, 223, 223, 2, 1, 155, ALPHA, ALPHA, ALPHA, ALPHA, ALPHA, ALPHA, 155, 146, 51, 223, 223, 32, 32, 51, 51, 155, ALPHA, ALPHA, ALPHA, ALPHA, 155, 155, 32, 32, 32, 32, 32, ALPHA, 51, 51, ALPHA, ALPHA, ALPHA, ALPHA, ALPHA, ALPHA, 32, 32, 32, 32, 32, 32, ALPHA, ALPHA, ALPHA, ALPHA, ALPHA, ALPHA, ALPHA, ALPHA, 32, 32, 32, 32, 32, 32, 32, ALPHA, ALPHA, ALPHA, ALPHA, ALPHA, 32, 32, ALPHA, ALPHA, 51, 32, 32, 155, 155, ALPHA, ALPHA, ALPHA, ALPHA, ALPHA, 32, 2, ALPHA, 2, 2, 2, 51, ALPHA, 155, 155, 2, ALPHA, ALPHA, ALPHA, ALPHA, ALPHA, ALPHA, ALPHA, ALPHA, 2, 2, ALPHA, ALPHA, ALPHA, 2, 2, ALPHA, ALPHA, ALPHA, ALPHA, ALPHA, ALPHA, ALPHA, ALPHA, ALPHA, ALPHA, ALPHA, ALPHA, ALPHA, ALPHA, 2, ALPHA, ALPHA, ALPHA, ALPHA, ALPHA, ALPHA, ALPHA, ALPHA, ALPHA, ALPHA, ALPHA, ALPHA, ALPHA, ALPHA, 2, 2, ALPHA, ALPHA, ALPHA, ALPHA, ALPHA, ALPHA, ALPHA, ALPHA, ALPHA, ALPHA, ALPHA, ALPHA, ALPHA, ALPHA, 2, 2, 32, ALPHA, ALPHA, ALPHA, ALPHA, ALPHA, ALPHA, ALPHA, ALPHA, ALPHA, ALPHA, ALPHA, ALPHA, 32, 32, ALPHA, ALPHA}; 
const unsigned char RUN_1[280] PROGMEM = {ALPHA, ALPHA, ALPHA, ALPHA, ALPHA, ALPHA, ALPHA, ALPHA, ALPHA, 223, 223, 223, ALPHA, ALPHA, ALPHA, ALPHA, ALPHA, ALPHA, ALPHA, ALPHA, ALPHA, 223, 223, 223, 2, 1, 1, ALPHA, ALPHA, ALPHA, ALPHA, ALPHA, ALPHA, ALPHA, ALPHA, 223, 223, 223, 1, 51, 1, 1, ALPHA, ALPHA, ALPHA, ALPHA, ALPHA, 146, 223, 223, 223, 2, 1, 32, 1, 146, ALPHA, ALPHA, ALPHA, ALPHA, ALPHA, 223, 223, 223, 223, 2, 223, 1, 1, 146, ALPHA, ALPHA, ALPHA, ALPHA, ALPHA, 146, 223, 223, 223, 2, 1, 155, 51, 32, ALPHA, ALPHA, ALPHA, ALPHA, ALPHA, ALPHA, 146, 146, 146, 2, 1, 1, 1, 32, ALPHA, ALPHA, ALPHA, ALPHA, ALPHA, 155, 223, 146, 146, 146, 1, 1, 1, ALPHA, ALPHA, ALPHA, ALPHA, ALPHA, 155, 51, 2, 223, 223, 223, 32, 146, ALPHA, ALPHA, ALPHA, ALPHA, ALPHA, 155, 51, ALPHA, 32, 32, 32, 32, 32, 155, 155, ALPHA, ALPHA, ALPHA, ALPHA, ALPHA, ALPHA, 32, 32, 32, 32, 32, ALPHA, 51, ALPHA, ALPHA, ALPHA, ALPHA, ALPHA, 32, 32, 32, 32, 32, 32, 32, ALPHA, ALPHA, ALPHA, ALPHA, ALPHA, 32, 32, ALPHA, 32, 32, 32, 32, 32, ALPHA, ALPHA, ALPHA, ALPHA, ALPHA, 32, 2, 2, 2, 51, 51, 155, 155, 155, ALPHA, ALPHA, ALPHA, ALPHA, ALPHA, ALPHA, ALPHA, ALPHA, 2, 2, 51, ALPHA, 2, 2, ALPHA, ALPHA, ALPHA, ALPHA, ALPHA, ALPHA, ALPHA, ALPHA, 2, 2, ALPHA, ALPHA, 2, 2, ALPHA, ALPHA, ALPHA, ALPHA, ALPHA, ALPHA, ALPHA, ALPHA, ALPHA, ALPHA, ALPHA, ALPHA, 2, 2, ALPHA, ALPHA, ALPHA, ALPHA, ALPHA, ALPHA, ALPHA, ALPHA, ALPHA, ALPHA, ALPHA, ALPHA, 2, 2, ALPHA, ALPHA, ALPHA, ALPHA, ALPHA, ALPHA, ALPHA, ALPHA, ALPHA, ALPHA, ALPHA, ALPHA, ALPHA, 32, 2, 32, ALPHA, ALPHA, ALPHA, ALPHA, ALPHA, ALPHA, ALPHA, ALPHA, ALPHA, ALPHA, ALPHA, 32, 32, ALPHA, ALPHA, ALPHA, ALPHA}; 
const unsigned char RUN_2[209] PROGMEM = {ALPHA, ALPHA, ALPHA, ALPHA, ALPHA, 223, 223, 223, 223, 2, ALPHA, ALPHA, ALPHA, ALPHA, ALPHA, 223, 223, 223, 223, 1, 1, 1, ALPHA, ALPHA, ALPHA, 223, 223, 223, 223, 223, 1, 1, 1, ALPHA, ALPHA, 223, 223, 223, 223, 223, 2, 51, 146, 1, ALPHA, ALPHA, ALPHA, 223, 223, 223, 223, 2, 1, 223, 32, ALPHA, ALPHA, ALPHA, 146, 223, 223, 223, 2, 1, 155, 32, ALPHA, ALPHA, ALPHA, ALPHA, 146, 146, 146, 146, 1, 1, 1, ALPHA, 223, 2, 223, 223, 223, 223, 2, 146, ALPHA, ALPHA, ALPHA, 146, 146, 51, 32, 32, 32, 32, 146, ALPHA, ALPHA, ALPHA, 146, 146, 51, 155, 51, 51, 32, ALPHA, ALPHA, ALPHA, ALPHA, ALPHA, 32, 32, 32, 32, 32, ALPHA, ALPHA, ALPHA, ALPHA, ALPHA, 32, 32, 32, 32, 32, 32, ALPHA, ALPHA, ALPHA, ALPHA, ALPHA, ALPHA, 32, 32, 32, 32, 32, ALPHA, ALPHA, ALPHA, ALPHA, 32, 2, 2, 2, 155, 51, 51, ALPHA, ALPHA, ALPHA, ALPHA, 2, ALPHA, 2, 2, 2, 2, 51, ALPHA, ALPHA, ALPHA, ALPHA, 32, ALPHA, 2, 2, 2, 2, ALPHA, ALPHA, ALPHA, ALPHA, ALPHA, ALPHA, ALPHA, 2, 2, ALPHA, ALPHA, ALPHA, ALPHA, ALPHA, ALPHA, ALPHA, ALPHA, ALPHA, 32, ALPHA, ALPHA, ALPHA, ALPHA, ALPHA, ALPHA, ALPHA, ALPHA, ALPHA, ALPHA, 32, 32, ALPHA, ALPHA, ALPHA, ALPHA, ALPHA, ALPHA, ALPHA}; 
const unsigned char RUN_3[228] PROGMEM = {ALPHA, ALPHA, ALPHA, ALPHA, ALPHA, ALPHA, ALPHA, 223, 223, 223, ALPHA, ALPHA, ALPHA, ALPHA, ALPHA, ALPHA, ALPHA, 223, 223, 223, 223, 2, 1, 1, ALPHA, ALPHA, ALPHA, ALPHA, ALPHA, 223, 223, 223, 223, 1, 1, 1, ALPHA, ALPHA, ALPHA, ALPHA, 223, 223, 223, 223, 2, 1, 146, 1, ALPHA, ALPHA, ALPHA, 223, 223, 223, 223, 223, 2, 1, 223, 146, ALPHA, ALPHA, ALPHA, 146, 223, 223, 223, 223, 223, 1, 155, 146, ALPHA, ALPHA, ALPHA, ALPHA, ALPHA, 146, 146, 146, 146, 1, 1, ALPHA, ALPHA, ALPHA, 2, 2, 2, 223, 223, 223, 2, 146, 51, 1, ALPHA, ALPHA, 146, 146, 146, 32, 2, 155, 155, 155, 51, 51, ALPHA, ALPHA, 146, 146, 32, 32, 32, 32, 32, 155, ALPHA, ALPHA, ALPHA, ALPHA, ALPHA, 32, 32, 32, 32, 32, ALPHA, ALPHA, ALPHA, ALPHA, ALPHA, ALPHA, 32, 32, 32, 32, 32, 32, ALPHA, ALPHA, ALPHA, ALPHA, ALPHA, ALPHA, ALPHA, ALPHA, 32, 32, 51, 32, ALPHA, ALPHA, ALPHA, ALPHA, ALPHA, ALPHA, ALPHA, 2, 2, 51, 2, 2, ALPHA, ALPHA, ALPHA, ALPHA, ALPHA, ALPHA, ALPHA, 2, 2, 2, 2, 2, ALPHA, ALPHA, ALPHA, ALPHA, ALPHA, ALPHA, 2, 2, 2, 2, 2, ALPHA, ALPHA, ALPHA, ALPHA, ALPHA, ALPHA, 2, 2, 32, 2, ALPHA, ALPHA, ALPHA, ALPHA, ALPHA, ALPHA, ALPHA, 32, 2, ALPHA, 32, ALPHA, ALPHA, ALPHA, ALPHA, ALPHA, ALPHA, ALPHA, ALPHA, ALPHA, 32, 32, ALPHA, ALPHA, ALPHA, ALPHA, ALPHA, ALPHA, ALPHA, ALPHA, ALPHA}; 
const unsigned char RUN_4[285] PROGMEM = {ALPHA, ALPHA, ALPHA, ALPHA, ALPHA, ALPHA, ALPHA, ALPHA, ALPHA, ALPHA, 223, 223, 2, 1, ALPHA, ALPHA, ALPHA, ALPHA, ALPHA, ALPHA, ALPHA, ALPHA, ALPHA, 223, 223, 223, 223, 1, 1, 1, ALPHA, ALPHA, ALPHA, ALPHA, ALPHA, ALPHA, ALPHA, 223, 223, 223, 223, 223, 1, 1, 1, ALPHA, ALPHA, ALPHA, ALPHA, ALPHA, ALPHA, 223, 223, 223, 223, 223, 2, 32, 32, ALPHA, ALPHA, ALPHA, ALPHA, ALPHA, ALPHA, ALPHA, 223, 223, 223, 223, 223, 2, 51, 32, ALPHA, ALPHA, ALPHA, ALPHA, ALPHA, ALPHA, ALPHA, 146, 146, 146, 223, 223, 223, 1, 32, ALPHA, ALPHA, ALPHA, ALPHA, ALPHA, ALPHA, ALPHA, ALPHA, 146, 146, 146, 146, 146, 1, 32, ALPHA, ALPHA, ALPHA, ALPHA, ALPHA, ALPHA, 146, 146, 146, 223, 223, 223, 2, 32, 51, 51, ALPHA, ALPHA, ALPHA, ALPHA, ALPHA, 2, 223, 223, 223, 223, 2, 155, 155, 51, ALPHA, ALPHA, ALPHA, ALPHA, ALPHA, 51, 51, ALPHA, 2, 2, 32, 32, ALPHA, 155, ALPHA, ALPHA, ALPHA, ALPHA, ALPHA, ALPHA, ALPHA, 32, 32, 32, 32, 32, 32, ALPHA, ALPHA, ALPHA, ALPHA, ALPHA, ALPHA, ALPHA, ALPHA, 32, 32, 32, 32, 32, 32, 32, ALPHA, ALPHA, ALPHA, ALPHA, ALPHA, 32, 32, ALPHA, ALPHA, 155, 32, 32, 32, 32, ALPHA, ALPHA, ALPHA, ALPHA, ALPHA, 32, 2, ALPHA, 2, 2, 2, 155, ALPHA, 51, 51, 2, ALPHA, ALPHA, ALPHA, ALPHA, ALPHA, ALPHA, ALPHA, ALPHA, 2, 2, ALPHA, ALPHA, ALPHA, 2, 2, ALPHA, ALPHA, ALPHA, ALPHA, ALPHA, ALPHA, ALPHA, ALPHA, ALPHA, ALPHA, ALPHA, ALPHA, ALPHA, ALPHA, 2, ALPHA, ALPHA, ALPHA, ALPHA, ALPHA, ALPHA, ALPHA, ALPHA, ALPHA, ALPHA, ALPHA, ALPHA, ALPHA, ALPHA, 2, 2, ALPHA, ALPHA, ALPHA, ALPHA, ALPHA, ALPHA, ALPHA, ALPHA, ALPHA, ALPHA, ALPHA, ALPHA, ALPHA, ALPHA, 2, 2, 32, ALPHA, ALPHA, ALPHA, ALPHA, ALPHA, ALPHA, ALPHA, ALPHA, ALPHA, ALPHA, ALPHA, ALPHA, 32, 32, ALPHA, ALPHA}; 
const unsigned char RUN_5[280] PROGMEM = {ALPHA, ALPHA, ALPHA, ALPHA, ALPHA, ALPHA, ALPHA, ALPHA, ALPHA, 223, 223, 1, ALPHA, ALPHA, ALPHA, ALPHA, ALPHA, ALPHA, ALPHA, ALPHA, ALPHA, 223, 223, 223, 2, 1, 1, ALPHA, ALPHA, ALPHA, ALPHA, ALPHA, ALPHA, ALPHA, 223, 223, 223, 223, 2, 1, 1, 1, ALPHA, ALPHA, ALPHA, ALPHA, ALPHA, 223, 223, 223, 223, 223, 2, 1, 32, 1, ALPHA, ALPHA, ALPHA, ALPHA, ALPHA, 223, 223, 223, 223, 223, 2, 1, 1, 146, ALPHA, ALPHA, ALPHA, ALPHA, ALPHA, ALPHA, 146, 223, 223, 223, 223, 1, 51, 146, ALPHA, ALPHA, ALPHA, ALPHA, ALPHA, ALPHA, 146, 146, 146, 146, 146, 1, 1, ALPHA, ALPHA, ALPHA, ALPHA, ALPHA, ALPHA, 146, 146, 223, 146, 146, 146, 32, ALPHA, ALPHA, ALPHA, ALPHA, ALPHA, ALPHA, 2, 223, 223, 223, 223, 223, 32, ALPHA, ALPHA, ALPHA, ALPHA, ALPHA, ALPHA, ALPHA, 51, 2, 223, 223, 223, 2, 155, 155, 51, 155, ALPHA, ALPHA, ALPHA, ALPHA, ALPHA, 32, 32, 32, 2, 32, 155, 155, 51, ALPHA, ALPHA, ALPHA, ALPHA, 32, 32, 32, 32, 32, 32, 32, ALPHA, ALPHA, ALPHA, ALPHA, ALPHA, 32, 32, ALPHA, 32, 32, 32, 32, 32, ALPHA, ALPHA, ALPHA, ALPHA, ALPHA, 32, 2, 2, 2, 2, 155, 155, 51, 51, ALPHA, ALPHA, ALPHA, ALPHA, ALPHA, ALPHA, ALPHA, ALPHA, 2, 2, 2, ALPHA, 2, 2, ALPHA, ALPHA, ALPHA, ALPHA, ALPHA, ALPHA, ALPHA, ALPHA, 2, 2, 2, ALPHA, 2, 2, ALPHA, ALPHA, ALPHA, ALPHA, ALPHA, ALPHA, ALPHA, ALPHA, ALPHA, ALPHA, ALPHA, ALPHA, 2, 2, ALPHA, ALPHA, ALPHA, ALPHA, ALPHA, ALPHA, ALPHA, ALPHA, ALPHA, ALPHA, ALPHA, ALPHA, 2, 2, ALPHA, ALPHA, ALPHA, ALPHA, ALPHA, ALPHA, ALPHA, ALPHA, ALPHA, ALPHA, ALPHA, ALPHA, ALPHA, 32, 2, 32, ALPHA, ALPHA, ALPHA, ALPHA, ALPHA, ALPHA, ALPHA, ALPHA, ALPHA, ALPHA, ALPHA, 32, 32, ALPHA, ALPHA, ALPHA, ALPHA}; 
const unsigned char RUN_6[228] PROGMEM = {ALPHA, ALPHA, ALPHA, ALPHA, ALPHA, ALPHA, 223, 223, 223, 1, 32, ALPHA, ALPHA, ALPHA, ALPHA, ALPHA, ALPHA, 223, 223, 223, 1, 1, 1, 146, ALPHA, ALPHA, ALPHA, ALPHA, 223, 223, 223, 2, 1, 51, 1, 1, ALPHA, ALPHA, ALPHA, 223, 223, 223, 223, 2, 32, 146, 1, 32, ALPHA, ALPHA, ALPHA, 223, 223, 223, 223, 223, 1, 223, 51, 146, ALPHA, ALPHA, ALPHA, 146, 223, 223, 223, 223, 1, 155, 51, ALPHA, ALPHA, ALPHA, ALPHA, ALPHA, 146, 146, 146, 146, 2, 32, 1, ALPHA, ALPHA, ALPHA, ALPHA, ALPHA, 223, 223, 223, 223, 2, ALPHA, ALPHA, ALPHA, ALPHA, ALPHA, ALPHA, 223, 223, 223, 2, 32, 32, ALPHA, ALPHA, ALPHA, ALPHA, ALPHA, ALPHA, 32, 223, 2, 155, 32, 32, ALPHA, ALPHA, ALPHA, ALPHA, ALPHA, 32, 32, 32, 32, 51, 155, 155, 155, ALPHA, ALPHA, ALPHA, 32, 32, 32, 32, 32, 32, 32, ALPHA, ALPHA, ALPHA, ALPHA, ALPHA, ALPHA, ALPHA, 32, 32, 155, 155, ALPHA, ALPHA, ALPHA, ALPHA, ALPHA, 32, 2, 2, 2, 2, 2, 2, ALPHA, ALPHA, ALPHA, ALPHA, ALPHA, 2, ALPHA, 2, 2, 2, 2, 2, ALPHA, ALPHA, ALPHA, ALPHA, ALPHA, 32, ALPHA, ALPHA, 2, ALPHA, ALPHA, ALPHA, ALPHA, ALPHA, ALPHA, ALPHA, ALPHA, ALPHA, ALPHA, 2, 2, ALPHA, ALPHA, ALPHA, ALPHA, ALPHA, ALPHA, ALPHA, ALPHA, ALPHA, ALPHA, 32, ALPHA, ALPHA, ALPHA, ALPHA, ALPHA, ALPHA, ALPHA, ALPHA, ALPHA, ALPHA, ALPHA, 32, 32, ALPHA, ALPHA, ALPHA, ALPHA, ALPHA, ALPHA, ALPHA, ALPHA}; 
const unsigned char RUN_7[247] PROGMEM = {ALPHA, ALPHA, ALPHA, ALPHA, ALPHA, ALPHA, ALPHA, 223, 223, 223, 146, ALPHA, ALPHA, ALPHA, ALPHA, ALPHA, ALPHA, ALPHA, 223, 223, 223, 223, 1, 1, 1, ALPHA, ALPHA, ALPHA, ALPHA, ALPHA, ALPHA, 223, 223, 223, 2, 1, 51, 1, ALPHA, ALPHA, ALPHA, ALPHA, ALPHA, 223, 223, 223, 223, 1, 146, 32, 1, 146, ALPHA, ALPHA, ALPHA, 146, 223, 223, 223, 223, 1, 223, 32, 32, 146, ALPHA, ALPHA, ALPHA, 146, 223, 223, 223, 223, 1, 51, 155, 32, ALPHA, ALPHA, ALPHA, ALPHA, ALPHA, 146, 146, 146, 146, 2, 1, 1, 146, ALPHA, ALPHA, ALPHA, ALPHA, ALPHA, 223, 223, 223, 223, 2, 32, 155, ALPHA, ALPHA, ALPHA, ALPHA, ALPHA, 51, 51, 223, 223, 223, 32, 51, 51, ALPHA, ALPHA, ALPHA, ALPHA, ALPHA, 155, 32, 32, 2, 32, 32, ALPHA, ALPHA, ALPHA, ALPHA, ALPHA, ALPHA, ALPHA, 155, 32, 32, 32, 32, 32, ALPHA, ALPHA, ALPHA, ALPHA, ALPHA, ALPHA, 32, 32, 32, 32, 32, 32, ALPHA, ALPHA, ALPHA, ALPHA, ALPHA, ALPHA, ALPHA, ALPHA, 32, 32, 32, 155, 32, ALPHA, ALPHA, ALPHA, ALPHA, ALPHA, ALPHA, ALPHA, ALPHA, 2, 2, 155, 2, 2, ALPHA, ALPHA, ALPHA, ALPHA, ALPHA, ALPHA, ALPHA, ALPHA, 2, 2, 2, 2, 2, ALPHA, ALPHA, ALPHA, ALPHA, ALPHA, ALPHA, ALPHA, 2, 2, 2, 2, 2, ALPHA, ALPHA, ALPHA, ALPHA, ALPHA, ALPHA, ALPHA, 2, 32, 32, 2, ALPHA, ALPHA, ALPHA, ALPHA, ALPHA, ALPHA, ALPHA, ALPHA, 32, 32, ALPHA, 32, ALPHA, ALPHA, ALPHA, ALPHA, ALPHA, ALPHA, ALPHA, ALPHA, ALPHA, ALPHA, 32, ALPHA, ALPHA, ALPHA, ALPHA, ALPHA, ALPHA, ALPHA, ALPHA, ALPHA, ALPHA, ALPHA}; 
const long RUN_ARR[8] PROGMEM = {RUN_0, RUN_1, RUN_2, RUN_3, RUN_4, RUN_5, RUN_6, RUN_7};

const char IDLE_disp[12] PROGMEM = {0, 0, 0, 0, 0, 0, -1, 0, -1, 0, 1, 0};
const char IDLE_disp2[6] PROGMEM = {-1, 0, -1, -2, -1, -2};
const unsigned char IDLE_XY[12] PROGMEM = {11, 20, 10, 20, 11, 20, 13, 20, 12, 20, 10, 20};
const unsigned char IDLE_0[220] PROGMEM = {ALPHA, ALPHA, ALPHA, 223, 223, 223, 2, 146, ALPHA, ALPHA, ALPHA, ALPHA, ALPHA, ALPHA, 223, 223, 2, 1, 1, ALPHA, ALPHA, ALPHA, ALPHA, ALPHA, 223, 223, 1, 1, 1, 1, 1, ALPHA, ALPHA, ALPHA, ALPHA, 223, 2, 146, 32, 51, 146, 1, 146, ALPHA, ALPHA, 146, 223, 1, 223, 32, 155, 223, 32, 32, ALPHA, 146, 146, 146, 146, 1, 32, 32, 146, 32, 146, ALPHA, ALPHA, ALPHA, ALPHA, 223, 1, 1, 2, 223, 1, 1, ALPHA, ALPHA, ALPHA, ALPHA, 223, 1, 1, 2, 223, 1, ALPHA, ALPHA, ALPHA, ALPHA, 223, 223, 223, 32, 32, 223, 223, ALPHA, ALPHA, ALPHA, ALPHA, 146, 2, 223, 32, 32, 223, 223, 2, ALPHA, ALPHA, ALPHA, 155, ALPHA, 32, 32, 32, 32, 51, 51, ALPHA, ALPHA, ALPHA, 155, 32, 32, 32, 32, 32, 32, 51, ALPHA, ALPHA, 155, 155, 32, 32, 32, 32, 32, 32, 155, 155, ALPHA, ALPHA, 32, 32, 32, 32, 51, 51, ALPHA, ALPHA, ALPHA, ALPHA, ALPHA, ALPHA, 51, 51, ALPHA, 51, 51, ALPHA, ALPHA, ALPHA, ALPHA, ALPHA, ALPHA, 2, ALPHA, ALPHA, 2, 2, ALPHA, ALPHA, ALPHA, ALPHA, ALPHA, 2, 2, ALPHA, ALPHA, 2, ALPHA, ALPHA, ALPHA, ALPHA, ALPHA, ALPHA, 2, ALPHA, ALPHA, ALPHA, 2, ALPHA, ALPHA, ALPHA, ALPHA, ALPHA, 32, 2, ALPHA, ALPHA, ALPHA, 32, ALPHA, ALPHA, ALPHA, ALPHA, 32, 32, 32, ALPHA, ALPHA, ALPHA, 32, 32, ALPHA, ALPHA, ALPHA}; 
const unsigned char IDLE_1[200] PROGMEM = {ALPHA, ALPHA, ALPHA, 223, 223, 2, 1, 1, ALPHA, ALPHA, ALPHA, ALPHA, ALPHA, 223, 2, 1, 1, 1, 1, ALPHA, ALPHA, ALPHA, 223, 223, 1, 1, 1, 1, 1, 1, ALPHA, ALPHA, 223, 2, 146, 32, 51, 146, 1, 146, ALPHA, 146, 223, 1, 223, 32, 155, 223, 32, 32, 146, 146, 146, 146, 1, 32, 32, 146, 32, 146, ALPHA, ALPHA, 146, 223, 1, 1, 2, 223, 1, ALPHA, ALPHA, ALPHA, ALPHA, 223, 223, 223, 32, 223, ALPHA, ALPHA, ALPHA, ALPHA, 2, 223, 223, 32, 32, 223, 223, 223, ALPHA, ALPHA, 51, 51, 32, 32, 32, 32, 2, 51, ALPHA, ALPHA, 155, ALPHA, 32, 32, 32, 32, 51, 51, ALPHA, 155, 155, 32, 32, 32, 32, 32, 32, 51, ALPHA, 155, ALPHA, 32, 32, 32, 32, 32, 32, 155, ALPHA, ALPHA, ALPHA, 51, 51, ALPHA, 51, 51, ALPHA, ALPHA, ALPHA, ALPHA, ALPHA, 51, 51, ALPHA, 51, 51, ALPHA, ALPHA, ALPHA, ALPHA, 2, 2, ALPHA, ALPHA, 2, 2, ALPHA, ALPHA, ALPHA, ALPHA, 2, 2, ALPHA, ALPHA, 2, ALPHA, ALPHA, ALPHA, ALPHA, ALPHA, 2, ALPHA, ALPHA, ALPHA, 2, ALPHA, ALPHA, ALPHA, ALPHA, 32, 32, ALPHA, ALPHA, ALPHA, 32, 32, ALPHA, ALPHA, 32, 32, 32, ALPHA, ALPHA, ALPHA, 32, 32, ALPHA, ALPHA}; 
const unsigned char IDLE_2[220] PROGMEM = {ALPHA, ALPHA, ALPHA, 223, 223, 2, 1, 1, ALPHA, ALPHA, ALPHA, ALPHA, ALPHA, ALPHA, 223, 2, 1, 1, 1, 1, ALPHA, ALPHA, ALPHA, ALPHA, 223, 223, 1, 1, 1, 1, 1, 1, ALPHA, ALPHA, ALPHA, 223, 2, 146, 32, 51, 146, 1, 146, ALPHA, ALPHA, 146, 223, 1, 223, 32, 155, 223, 32, 32, ALPHA, 146, 146, 146, 146, 1, 32, 32, 146, 32, 146, ALPHA, ALPHA, ALPHA, ALPHA, 223, 1, 1, 2, 223, 1, ALPHA, ALPHA, ALPHA, ALPHA, 146, 223, 223, 223, 32, 223, 223, ALPHA, ALPHA, ALPHA, ALPHA, 2, 223, 223, 32, 32, 223, 223, 146, ALPHA, ALPHA, ALPHA, 51, 51, 32, 32, 32, 32, 2, 51, ALPHA, ALPHA, 155, 155, 32, 32, 32, 32, 32, 51, 51, ALPHA, 155, 155, ALPHA, 32, 32, 32, 32, 32, 32, 51, 155, ALPHA, ALPHA, 32, 32, 32, 32, 32, 32, 32, ALPHA, 155, ALPHA, ALPHA, ALPHA, 51, 51, 32, 32, 32, 32, ALPHA, ALPHA, ALPHA, ALPHA, ALPHA, 51, 51, ALPHA, 51, 51, ALPHA, ALPHA, ALPHA, ALPHA, ALPHA, 2, 2, ALPHA, ALPHA, 2, 2, ALPHA, ALPHA, ALPHA, ALPHA, ALPHA, 2, 2, ALPHA, ALPHA, 2, ALPHA, ALPHA, ALPHA, ALPHA, ALPHA, ALPHA, 2, ALPHA, ALPHA, ALPHA, 2, ALPHA, ALPHA, ALPHA, ALPHA, ALPHA, 32, 32, ALPHA, ALPHA, ALPHA, 32, 2, ALPHA, ALPHA, ALPHA, 32, 32, ALPHA, ALPHA, ALPHA, ALPHA, 32, 32, ALPHA, ALPHA, ALPHA}; 
const unsigned char IDLE_3[260] PROGMEM = {ALPHA, ALPHA, ALPHA, ALPHA, ALPHA, 223, 223, 2, 146, ALPHA, ALPHA, ALPHA, ALPHA, ALPHA, ALPHA, ALPHA, ALPHA, 223, 223, 2, 1, 1, ALPHA, ALPHA, ALPHA, ALPHA, ALPHA, ALPHA, ALPHA, 223, 223, 1, 1, 1, 1, 1, ALPHA, ALPHA, ALPHA, ALPHA, ALPHA, ALPHA, 223, 2, 32, 32, 51, 32, 1, 1, ALPHA, ALPHA, ALPHA, ALPHA, 146, 223, 1, 223, 1, 155, 223, 32, 32, ALPHA, ALPHA, ALPHA, 146, 146, 146, 1, 1, 155, 155, 51, 32, 32, ALPHA, ALPHA, ALPHA, ALPHA, ALPHA, 146, 223, 1, 2, 2, 223, 1, 1, ALPHA, ALPHA, ALPHA, ALPHA, ALPHA, ALPHA, 223, 223, 223, 2, 223, 1, ALPHA, ALPHA, ALPHA, ALPHA, ALPHA, ALPHA, 223, 223, 223, 32, 32, 223, 223, 223, ALPHA, ALPHA, ALPHA, ALPHA, ALPHA, 2, 223, 32, 32, 32, 32, 146, 2, ALPHA, ALPHA, ALPHA, ALPHA, 51, 155, ALPHA, 32, 32, 32, 32, 51, 51, ALPHA, ALPHA, ALPHA, 155, 155, ALPHA, 32, 32, 32, 32, 32, 32, 51, 51, ALPHA, 155, 155, 155, 32, 32, 32, 32, 32, 32, 32, ALPHA, 155, 155, ALPHA, ALPHA, ALPHA, ALPHA, 51, 32, 32, 32, 32, 32, ALPHA, ALPHA, ALPHA, ALPHA, ALPHA, ALPHA, ALPHA, 51, 51, 32, 32, 51, ALPHA, ALPHA, ALPHA, ALPHA, ALPHA, ALPHA, ALPHA, ALPHA, 2, ALPHA, ALPHA, 2, 2, ALPHA, ALPHA, ALPHA, ALPHA, ALPHA, ALPHA, ALPHA, 2, 2, ALPHA, ALPHA, 2, ALPHA, ALPHA, ALPHA, ALPHA, ALPHA, ALPHA, ALPHA, ALPHA, 2, ALPHA, ALPHA, ALPHA, 2, ALPHA, ALPHA, ALPHA, ALPHA, ALPHA, ALPHA, ALPHA, 32, 32, ALPHA, ALPHA, ALPHA, 32, 32, ALPHA, ALPHA, ALPHA, ALPHA, ALPHA, 32, 32, 32, ALPHA, ALPHA, ALPHA, 32, 32, ALPHA, ALPHA, ALPHA, ALPHA}; 
const unsigned char IDLE_4[240] PROGMEM = {ALPHA, ALPHA, ALPHA, ALPHA, 223, 223, 223, 2, 146, ALPHA, ALPHA, ALPHA, ALPHA, ALPHA, ALPHA, ALPHA, 223, 223, 2, 1, 1, ALPHA, ALPHA, ALPHA, ALPHA, ALPHA, ALPHA, 223, 223, 1, 1, 1, 1, 1, ALPHA, ALPHA, ALPHA, ALPHA, 146, 223, 2, 32, 32, 51, 32, 1, 1, ALPHA, ALPHA, 146, 146, 223, 1, 223, 1, 155, 223, 32, 32, ALPHA, ALPHA, 146, 146, 146, 1, 1, 155, 155, 51, 32, 146, ALPHA, ALPHA, ALPHA, ALPHA, ALPHA, 146, 1, 146, 146, 223, 1, 1, ALPHA, ALPHA, ALPHA, ALPHA, ALPHA, 223, 1, 1, 2, 223, 1, ALPHA, ALPHA, ALPHA, ALPHA, 2, 223, 223, 223, 223, 32, 223, 223, 223, ALPHA, ALPHA, ALPHA, 2, 2, 223, 146, 32, 32, 146, 223, 2, ALPHA, ALPHA, ALPHA, ALPHA, 155, ALPHA, 32, 32, 32, 32, 51, 51, ALPHA, ALPHA, ALPHA, 155, 155, 32, 32, 32, 32, 32, 32, 51, ALPHA, 155, 155, 155, 32, 32, 32, 32, 32, 32, 32, 51, 155, ALPHA, ALPHA, ALPHA, ALPHA, 32, 32, 32, 32, 32, ALPHA, ALPHA, 155, ALPHA, ALPHA, ALPHA, ALPHA, 51, 51, 32, 51, 51, ALPHA, ALPHA, ALPHA, ALPHA, ALPHA, ALPHA, ALPHA, 2, ALPHA, ALPHA, 2, 2, ALPHA, ALPHA, ALPHA, ALPHA, ALPHA, ALPHA, 2, 2, ALPHA, ALPHA, 2, ALPHA, ALPHA, ALPHA, ALPHA, ALPHA, ALPHA, ALPHA, 2, ALPHA, ALPHA, ALPHA, 2, ALPHA, ALPHA, ALPHA, ALPHA, ALPHA, ALPHA, 32, 2, ALPHA, ALPHA, ALPHA, 32, ALPHA, ALPHA, ALPHA, ALPHA, ALPHA, 32, 32, 32, ALPHA, ALPHA, ALPHA, 32, 32, ALPHA, ALPHA, ALPHA}; 
const unsigned char IDLE_5[200] PROGMEM = {ALPHA, ALPHA, 223, 223, 223, 2, 146, ALPHA, ALPHA, ALPHA, ALPHA, ALPHA, 223, 223, 2, 1, 1, ALPHA, ALPHA, ALPHA, ALPHA, 223, 223, 2, 1, 1, 1, 1, ALPHA, ALPHA, 146, 223, 223, 32, 32, 51, 32, 1, 146, ALPHA, 146, 223, 1, 223, 1, 155, 223, 32, 32, ALPHA, 146, 146, 1, 1, 155, 155, 51, 32, 146, ALPHA, ALPHA, ALPHA, 146, 1, 146, 146, 223, 1, 1, ALPHA, ALPHA, ALPHA, 223, 1, 1, 2, 223, 1, ALPHA, ALPHA, ALPHA, 223, 223, 223, 223, 32, 223, 223, ALPHA, ALPHA, ALPHA, 146, 2, 223, 32, 32, 223, 223, 2, ALPHA, ALPHA, 155, ALPHA, 32, 32, 32, 32, 51, 51, ALPHA, 155, 155, 32, 32, 32, 32, 32, 32, 51, ALPHA, 155, 32, 32, 32, 32, 32, 32, 32, ALPHA, 155, ALPHA, 32, 32, 32, 32, 32, 51, ALPHA, ALPHA, 155, ALPHA, ALPHA, 51, 51, ALPHA, 51, 51, ALPHA, ALPHA, ALPHA, ALPHA, ALPHA, 2, ALPHA, ALPHA, 2, 2, ALPHA, ALPHA, ALPHA, ALPHA, 2, 2, ALPHA, ALPHA, 2, ALPHA, ALPHA, ALPHA, ALPHA, ALPHA, 2, ALPHA, ALPHA, ALPHA, 2, ALPHA, ALPHA, ALPHA, ALPHA, 32, 2, ALPHA, ALPHA, ALPHA, 32, ALPHA, ALPHA, ALPHA, ALPHA, 32, 32, ALPHA, ALPHA, ALPHA, 32, 32, ALPHA, ALPHA, ALPHA}; 
const long IDLE_ARR[6] PROGMEM = {IDLE_0, IDLE_1, IDLE_2, IDLE_3, IDLE_4, IDLE_5};

const char TREE_disp[10] PROGMEM = {0, 0, -2, -2, -4, -9, -10, -28, -10, -29};
const char TREE_disp2[5] PROGMEM = {0, 1, -2, -9, -10};
const unsigned char TREE_XY[10] PROGMEM = {5, 4, 6, 6, 11, 13, 24, 32, 25, 33};
const unsigned char TREE_0[20] PROGMEM = {ALPHA, ALPHA, 84, ALPHA, 84, ALPHA, ALPHA, 84, 84, ALPHA, 84, ALPHA, ALPHA, 84, ALPHA, ALPHA, 84, 84, ALPHA, ALPHA}; 
const unsigned char TREE_1[36] PROGMEM = {58, ALPHA, ALPHA, ALPHA, ALPHA, ALPHA, ALPHA, 78, ALPHA, ALPHA, ALPHA, ALPHA, ALPHA, ALPHA, 78, ALPHA, ALPHA, 78, ALPHA, ALPHA, 78, ALPHA, 78, 58, ALPHA, ALPHA, ALPHA, 78, ALPHA, ALPHA, ALPHA, ALPHA, ALPHA, 78, ALPHA, ALPHA}; 
const unsigned char TREE_2[143] PROGMEM = {ALPHA, 58, 58, ALPHA, ALPHA, ALPHA, ALPHA, ALPHA, ALPHA, ALPHA, ALPHA, ALPHA, ALPHA, 78, ALPHA, ALPHA, ALPHA, ALPHA, ALPHA, ALPHA, 58, ALPHA, ALPHA, ALPHA, ALPHA, 78, ALPHA, 58, ALPHA, ALPHA, ALPHA, 58, ALPHA, ALPHA, ALPHA, ALPHA, ALPHA, ALPHA, 78, 78, 78, ALPHA, ALPHA, ALPHA, 58, ALPHA, ALPHA, ALPHA, ALPHA, 78, 78, ALPHA, ALPHA, ALPHA, ALPHA, 78, 78, ALPHA, ALPHA, ALPHA, ALPHA, ALPHA, ALPHA, ALPHA, 58, 58, ALPHA, ALPHA, 78, ALPHA, ALPHA, ALPHA, ALPHA, ALPHA, 78, 78, ALPHA, ALPHA, ALPHA, 78, 78, ALPHA, ALPHA, ALPHA, 78, 78, ALPHA, ALPHA, ALPHA, ALPHA, ALPHA, 58, 78, ALPHA, 78, 78, ALPHA, ALPHA, ALPHA, ALPHA, ALPHA, ALPHA, ALPHA, 78, 58, ALPHA, ALPHA, ALPHA, ALPHA, ALPHA, ALPHA, ALPHA, ALPHA, ALPHA, ALPHA, 78, ALPHA, ALPHA, ALPHA, ALPHA, ALPHA, ALPHA, ALPHA, ALPHA, ALPHA, ALPHA, 78, ALPHA, ALPHA, ALPHA, ALPHA, ALPHA, ALPHA, ALPHA, ALPHA, ALPHA, ALPHA, 78, ALPHA, ALPHA, ALPHA, ALPHA, ALPHA}; 
const unsigned char TREE_3[768] PROGMEM = {ALPHA, ALPHA, ALPHA, ALPHA, ALPHA, ALPHA, ALPHA, ALPHA, ALPHA, ALPHA, ALPHA, ALPHA, ALPHA, ALPHA, ALPHA, ALPHA, ALPHA, 41, 41, ALPHA, ALPHA, ALPHA, ALPHA, ALPHA, ALPHA, ALPHA, ALPHA, ALPHA, ALPHA, ALPHA, ALPHA, ALPHA, ALPHA, ALPHA, ALPHA, ALPHA, ALPHA, ALPHA, ALPHA, ALPHA, 58, 41, ALPHA, ALPHA, ALPHA, ALPHA, ALPHA, ALPHA, ALPHA, ALPHA, ALPHA, ALPHA, ALPHA, ALPHA, ALPHA, ALPHA, ALPHA, ALPHA, ALPHA, ALPHA, ALPHA, ALPHA, ALPHA, ALPHA, 58, 41, ALPHA, ALPHA, ALPHA, ALPHA, ALPHA, ALPHA, ALPHA, ALPHA, ALPHA, ALPHA, 41, ALPHA, ALPHA, 58, ALPHA, ALPHA, ALPHA, ALPHA, ALPHA, ALPHA, ALPHA, ALPHA, 41, ALPHA, ALPHA, ALPHA, ALPHA, ALPHA, ALPHA, ALPHA, ALPHA, ALPHA, ALPHA, ALPHA, ALPHA, 41, 41, 58, ALPHA, ALPHA, ALPHA, ALPHA, ALPHA, ALPHA, ALPHA, 41, ALPHA, ALPHA, ALPHA, ALPHA, ALPHA, ALPHA, ALPHA, ALPHA, ALPHA, ALPHA, ALPHA, ALPHA, ALPHA, ALPHA, 41, 41, ALPHA, ALPHA, ALPHA, ALPHA, ALPHA, ALPHA, 41, ALPHA, ALPHA, ALPHA, ALPHA, ALPHA, ALPHA, ALPHA, ALPHA, ALPHA, ALPHA, ALPHA, ALPHA, ALPHA, ALPHA, ALPHA, ALPHA, 41, ALPHA, ALPHA, ALPHA, ALPHA, ALPHA, 58, 41, ALPHA, ALPHA, ALPHA, ALPHA, ALPHA, ALPHA, ALPHA, ALPHA, ALPHA, ALPHA, ALPHA, ALPHA, 41, ALPHA, ALPHA, ALPHA, 41, 41, ALPHA, ALPHA, ALPHA, ALPHA, 41, ALPHA, ALPHA, ALPHA, ALPHA, ALPHA, ALPHA, ALPHA, 41, ALPHA, ALPHA, ALPHA, ALPHA, ALPHA, 41, 41, ALPHA, ALPHA, ALPHA, 41, 58, 58, ALPHA, 41, ALPHA, ALPHA, ALPHA, ALPHA, ALPHA, ALPHA, ALPHA, 41, 41, ALPHA, ALPHA, ALPHA, ALPHA, ALPHA, 58, 41, ALPHA, ALPHA, ALPHA, ALPHA, 41, 58, 41, 41, ALPHA, ALPHA, ALPHA, ALPHA, ALPHA, ALPHA, 58, 41, ALPHA, ALPHA, ALPHA, 41, 41, ALPHA, ALPHA, 41, ALPHA, ALPHA, ALPHA, ALPHA, 41, 41, 41, ALPHA, ALPHA, ALPHA, ALPHA, ALPHA, ALPHA, ALPHA, 41, 41, ALPHA, ALPHA, ALPHA, ALPHA, ALPHA, 41, ALPHA, ALPHA, 41, ALPHA, ALPHA, ALPHA, ALPHA, 41, 41, ALPHA, ALPHA, ALPHA, ALPHA, ALPHA, 41, 41, ALPHA, ALPHA, ALPHA, ALPHA, ALPHA, ALPHA, ALPHA, 58, 41, 41, 41, ALPHA, ALPHA, ALPHA, ALPHA, ALPHA, 41, ALPHA, ALPHA, ALPHA, ALPHA, ALPHA, 41, ALPHA, ALPHA, ALPHA, ALPHA, 58, 58, ALPHA, ALPHA, 41, ALPHA, 41, 41, 41, 58, ALPHA, ALPHA, ALPHA, 41, ALPHA, ALPHA, 58, 41, 41, 41, 41, 41, 41, 41, 58, ALPHA, ALPHA, ALPHA, ALPHA, ALPHA, ALPHA, ALPHA, 41, 41, ALPHA, ALPHA, 58, 41, 41, ALPHA, 58, 41, 41, ALPHA, ALPHA, ALPHA, ALPHA, 41, 41, 41, ALPHA, ALPHA, ALPHA, ALPHA, ALPHA, ALPHA, ALPHA, 41, 41, 41, 58, 41, 41, 41, 41, 41, ALPHA, ALPHA, ALPHA, ALPHA, ALPHA, ALPHA, ALPHA, ALPHA, ALPHA, ALPHA, ALPHA, ALPHA, ALPHA, ALPHA, 58, 58, 41, 41, 41, 58, 41, 41, 41, 58, ALPHA, ALPHA, ALPHA, ALPHA, ALPHA, ALPHA, ALPHA, ALPHA, ALPHA, ALPHA, ALPHA, ALPHA, ALPHA, ALPHA, ALPHA, ALPHA, 41, 41, 41, 58, 41, 41, ALPHA, 58, ALPHA, ALPHA, ALPHA, ALPHA, ALPHA, ALPHA, ALPHA, ALPHA, ALPHA, ALPHA, ALPHA, ALPHA, ALPHA, ALPHA, ALPHA, ALPHA, ALPHA, 41, 41, 41, 58, ALPHA, ALPHA, ALPHA, ALPHA, ALPHA, ALPHA, ALPHA, ALPHA, ALPHA, ALPHA, ALPHA, ALPHA, ALPHA, ALPHA, ALPHA, ALPHA, ALPHA, ALPHA, ALPHA, ALPHA, 41, 41, 41, ALPHA, ALPHA, ALPHA, ALPHA, ALPHA, ALPHA, ALPHA, ALPHA, ALPHA, ALPHA, ALPHA, ALPHA, ALPHA, ALPHA, ALPHA, ALPHA, ALPHA, ALPHA, ALPHA, ALPHA, ALPHA, 41, 41, 41, ALPHA, ALPHA, ALPHA, ALPHA, ALPHA, ALPHA, ALPHA, ALPHA, ALPHA, ALPHA, ALPHA, ALPHA, ALPHA, ALPHA, ALPHA, ALPHA, ALPHA, ALPHA, ALPHA, ALPHA, ALPHA, 41, 41, ALPHA, ALPHA, ALPHA, ALPHA, ALPHA, ALPHA, ALPHA, ALPHA, ALPHA, ALPHA, ALPHA, ALPHA, ALPHA, ALPHA, ALPHA, ALPHA, ALPHA, ALPHA, ALPHA, ALPHA, ALPHA, ALPHA, 41, 41, ALPHA, ALPHA, ALPHA, ALPHA, ALPHA, ALPHA, ALPHA, ALPHA, ALPHA, ALPHA, ALPHA, ALPHA, ALPHA, ALPHA, ALPHA, ALPHA, ALPHA, ALPHA, ALPHA, ALPHA, ALPHA, ALPHA, 41, 41, ALPHA, ALPHA, ALPHA, ALPHA, ALPHA, ALPHA, ALPHA, ALPHA, ALPHA, ALPHA, ALPHA, ALPHA, ALPHA, ALPHA, ALPHA, ALPHA, ALPHA, ALPHA, ALPHA, ALPHA, ALPHA, ALPHA, 41, 41, ALPHA, ALPHA, ALPHA, ALPHA, ALPHA, ALPHA, ALPHA, ALPHA, ALPHA, ALPHA, ALPHA, ALPHA, ALPHA, ALPHA, ALPHA, ALPHA, ALPHA, ALPHA, ALPHA, ALPHA, ALPHA, ALPHA, 41, 41, ALPHA, ALPHA, ALPHA, ALPHA, ALPHA, ALPHA, ALPHA, ALPHA, ALPHA, ALPHA, ALPHA, ALPHA, ALPHA, ALPHA, ALPHA, ALPHA, ALPHA, ALPHA, ALPHA, ALPHA, ALPHA, ALPHA, 41, 41, ALPHA, ALPHA, ALPHA, ALPHA, ALPHA, ALPHA, ALPHA, ALPHA, ALPHA, ALPHA, ALPHA, ALPHA, ALPHA, ALPHA, ALPHA, ALPHA, ALPHA, ALPHA, ALPHA, ALPHA, ALPHA, ALPHA, 41, 41, ALPHA, ALPHA, ALPHA, ALPHA, ALPHA, ALPHA, ALPHA, ALPHA, ALPHA, ALPHA, ALPHA, ALPHA, ALPHA, ALPHA, ALPHA, ALPHA, ALPHA, ALPHA, ALPHA, ALPHA, ALPHA, ALPHA, 41, 41, ALPHA, ALPHA, ALPHA, ALPHA, ALPHA, ALPHA, ALPHA, ALPHA, ALPHA, ALPHA, ALPHA, ALPHA, ALPHA, ALPHA, ALPHA, ALPHA, ALPHA, ALPHA, ALPHA, ALPHA, ALPHA, ALPHA, 41, 41, ALPHA, ALPHA, ALPHA, ALPHA, ALPHA, ALPHA, ALPHA, ALPHA, ALPHA, ALPHA, ALPHA, ALPHA, ALPHA, ALPHA, ALPHA, ALPHA, ALPHA, ALPHA, ALPHA, ALPHA, ALPHA, ALPHA, 41, 41, ALPHA, ALPHA, ALPHA, ALPHA, ALPHA, ALPHA, ALPHA, ALPHA, ALPHA, ALPHA, ALPHA, ALPHA, ALPHA, ALPHA, ALPHA, ALPHA, ALPHA, ALPHA, ALPHA, 58, ALPHA, ALPHA, 41, 41, ALPHA, ALPHA, ALPHA, ALPHA, ALPHA, ALPHA, ALPHA, ALPHA, 58, ALPHA, ALPHA, ALPHA, ALPHA}; 
const unsigned char TREE_4[825] PROGMEM = {ALPHA, ALPHA, ALPHA, ALPHA, ALPHA, ALPHA, ALPHA, ALPHA, ALPHA, ALPHA, ALPHA, ALPHA, ALPHA, ALPHA, ALPHA, ALPHA, ALPHA, ALPHA, ALPHA, ALPHA, 44, ALPHA, ALPHA, ALPHA, ALPHA, ALPHA, ALPHA, ALPHA, ALPHA, ALPHA, ALPHA, ALPHA, ALPHA, ALPHA, ALPHA, ALPHA, ALPHA, ALPHA, ALPHA, ALPHA, ALPHA, ALPHA, ALPHA, ALPHA, 41, 41, 44, ALPHA, ALPHA, ALPHA, ALPHA, ALPHA, ALPHA, ALPHA, ALPHA, ALPHA, ALPHA, ALPHA, ALPHA, 44, ALPHA, ALPHA, 44, ALPHA, ALPHA, 44, 44, 44, ALPHA, 41, 44, ALPHA, ALPHA, ALPHA, ALPHA, ALPHA, ALPHA, ALPHA, ALPHA, ALPHA, ALPHA, 44, 44, ALPHA, 44, 44, ALPHA, 44, ALPHA, ALPHA, ALPHA, 44, 44, 41, 41, 41, 41, ALPHA, ALPHA, ALPHA, ALPHA, ALPHA, ALPHA, ALPHA, ALPHA, ALPHA, 41, 44, 44, 44, 44, 44, 44, ALPHA, ALPHA, ALPHA, 44, 41, ALPHA, ALPHA, ALPHA, ALPHA, ALPHA, ALPHA, ALPHA, ALPHA, ALPHA, ALPHA, ALPHA, ALPHA, ALPHA, ALPHA, 41, 44, 41, 44, 44, 44, 44, 44, 44, 44, 44, 44, ALPHA, ALPHA, ALPHA, ALPHA, ALPHA, ALPHA, ALPHA, ALPHA, ALPHA, ALPHA, ALPHA, ALPHA, ALPHA, ALPHA, 41, 44, 44, 44, 44, 44, 44, 41, 44, 44, 44, 44, 44, 44, ALPHA, ALPHA, ALPHA, ALPHA, ALPHA, ALPHA, 44, 44, ALPHA, 44, ALPHA, 44, 44, 44, ALPHA, 44, 44, 44, 41, 44, 44, 44, 44, ALPHA, ALPHA, ALPHA, ALPHA, ALPHA, ALPHA, ALPHA, ALPHA, ALPHA, ALPHA, 44, 44, ALPHA, 41, 44, 44, 44, 44, 44, 41, 44, 44, 44, ALPHA, 44, 44, ALPHA, 44, 44, ALPHA, ALPHA, ALPHA, ALPHA, 44, 44, 44, 41, 44, 44, 41, 44, 41, 44, 41, 44, 44, 44, 41, 44, 44, 44, ALPHA, 41, ALPHA, ALPHA, ALPHA, ALPHA, ALPHA, 44, 44, 44, 41, 44, 44, 44, 44, 41, 44, 44, 44, 44, 44, 41, 41, 44, 44, 44, 44, ALPHA, ALPHA, 41, 41, 44, 44, 44, ALPHA, ALPHA, 44, 44, 44, 41, 41, 41, 44, ALPHA, 44, 44, 44, 44, 41, 44, 44, ALPHA, ALPHA, ALPHA, ALPHA, ALPHA, ALPHA, ALPHA, 41, 44, 44, 44, 41, 44, 44, 41, 41, 44, 41, 44, 44, 44, 44, 41, 44, 44, ALPHA, ALPHA, ALPHA, ALPHA, ALPHA, ALPHA, 44, 44, 41, 44, 44, 44, 44, 44, 44, 41, 44, 44, 44, 44, 44, 41, 41, 44, ALPHA, ALPHA, 44, 44, ALPHA, ALPHA, ALPHA, ALPHA, 44, 44, 41, 41, 41, ALPHA, ALPHA, 44, 41, 44, 44, 44, 44, 41, 44, 44, 41, 41, 41, 44, ALPHA, ALPHA, ALPHA, ALPHA, ALPHA, 44, 44, ALPHA, ALPHA, 41, 44, ALPHA, 44, 41, 41, 44, 44, 44, 41, 41, 41, 44, ALPHA, 44, 41, 41, ALPHA, ALPHA, ALPHA, 44, 44, 44, 44, 44, 44, 41, 41, 44, 44, 44, 41, 41, 41, ALPHA, 44, 41, 44, 44, 44, ALPHA, ALPHA, ALPHA, ALPHA, ALPHA, 44, ALPHA, ALPHA, ALPHA, ALPHA, 44, 41, 44, 41, 44, 44, 41, 41, 44, ALPHA, ALPHA, 44, ALPHA, ALPHA, ALPHA, ALPHA, ALPHA, ALPHA, ALPHA, ALPHA, ALPHA, ALPHA, ALPHA, ALPHA, ALPHA, 44, 44, 41, 41, 44, 44, 44, 44, 44, 44, 44, 44, 44, ALPHA, ALPHA, ALPHA, ALPHA, ALPHA, ALPHA, ALPHA, ALPHA, ALPHA, ALPHA, ALPHA, ALPHA, ALPHA, 44, 44, 41, 41, 44, ALPHA, ALPHA, 44, 44, ALPHA, ALPHA, ALPHA, ALPHA, ALPHA, ALPHA, ALPHA, ALPHA, ALPHA, ALPHA, ALPHA, ALPHA, ALPHA, ALPHA, ALPHA, ALPHA, ALPHA, 41, 41, 44, 44, 44, ALPHA, ALPHA, ALPHA, ALPHA, ALPHA, ALPHA, ALPHA, ALPHA, ALPHA, ALPHA, ALPHA, ALPHA, ALPHA, ALPHA, ALPHA, ALPHA, ALPHA, ALPHA, ALPHA, ALPHA, 41, 41, 41, ALPHA, ALPHA, ALPHA, ALPHA, ALPHA, ALPHA, ALPHA, ALPHA, ALPHA, ALPHA, ALPHA, ALPHA, ALPHA, ALPHA, ALPHA, ALPHA, ALPHA, ALPHA, ALPHA, ALPHA, ALPHA, ALPHA, 41, 41, ALPHA, ALPHA, ALPHA, ALPHA, ALPHA, ALPHA, ALPHA, ALPHA, ALPHA, ALPHA, ALPHA, ALPHA, ALPHA, ALPHA, ALPHA, ALPHA, ALPHA, ALPHA, ALPHA, ALPHA, ALPHA, ALPHA, ALPHA, 41, 41, ALPHA, ALPHA, ALPHA, ALPHA, ALPHA, ALPHA, ALPHA, ALPHA, ALPHA, ALPHA, ALPHA, ALPHA, ALPHA, ALPHA, ALPHA, ALPHA, ALPHA, ALPHA, ALPHA, ALPHA, ALPHA, ALPHA, ALPHA, 41, 41, ALPHA, ALPHA, ALPHA, ALPHA, ALPHA, ALPHA, ALPHA, ALPHA, ALPHA, ALPHA, ALPHA, ALPHA, ALPHA, ALPHA, ALPHA, ALPHA, ALPHA, ALPHA, ALPHA, ALPHA, ALPHA, ALPHA, ALPHA, 41, 41, ALPHA, ALPHA, ALPHA, ALPHA, ALPHA, ALPHA, ALPHA, ALPHA, ALPHA, ALPHA, ALPHA, ALPHA, ALPHA, ALPHA, ALPHA, ALPHA, ALPHA, ALPHA, ALPHA, ALPHA, ALPHA, ALPHA, ALPHA, 41, 41, ALPHA, ALPHA, ALPHA, ALPHA, ALPHA, ALPHA, ALPHA, ALPHA, ALPHA, ALPHA, ALPHA, ALPHA, ALPHA, ALPHA, ALPHA, ALPHA, ALPHA, ALPHA, ALPHA, ALPHA, ALPHA, ALPHA, ALPHA, 41, 41, ALPHA, ALPHA, ALPHA, ALPHA, ALPHA, ALPHA, ALPHA, ALPHA, ALPHA, ALPHA, ALPHA, ALPHA, ALPHA, ALPHA, ALPHA, ALPHA, ALPHA, ALPHA, ALPHA, ALPHA, ALPHA, ALPHA, ALPHA, 41, 41, ALPHA, ALPHA, ALPHA, ALPHA, ALPHA, ALPHA, ALPHA, ALPHA, ALPHA, ALPHA, ALPHA, ALPHA, ALPHA, ALPHA, ALPHA, ALPHA, ALPHA, ALPHA, ALPHA, ALPHA, ALPHA, ALPHA, ALPHA, 41, 41, ALPHA, ALPHA, ALPHA, ALPHA, ALPHA, ALPHA, ALPHA, ALPHA, ALPHA, ALPHA, ALPHA, ALPHA, ALPHA, ALPHA, ALPHA, ALPHA, ALPHA, ALPHA, ALPHA, ALPHA, ALPHA, ALPHA, ALPHA, 41, 41, ALPHA, ALPHA, ALPHA, ALPHA, ALPHA, ALPHA, ALPHA, ALPHA, ALPHA, ALPHA, ALPHA, ALPHA, ALPHA, ALPHA, ALPHA, ALPHA, ALPHA, ALPHA, ALPHA, ALPHA, ALPHA, ALPHA, ALPHA, 41, 41, ALPHA, ALPHA, ALPHA, ALPHA, ALPHA, ALPHA, ALPHA, ALPHA, ALPHA, ALPHA, ALPHA, ALPHA, ALPHA, ALPHA, ALPHA, ALPHA, ALPHA, ALPHA, ALPHA, ALPHA, ALPHA, ALPHA, ALPHA, 41, 41, ALPHA, ALPHA, ALPHA, ALPHA, ALPHA, ALPHA, ALPHA, ALPHA, ALPHA, 58, ALPHA, ALPHA, ALPHA}; 
const long TREE_ARR[5] PROGMEM = {TREE_0, TREE_1, TREE_2, TREE_3, TREE_4};

const unsigned char CLOUD1_XY[2] PROGMEM = {25, 12};
const unsigned char CLOUD1[300] PROGMEM = {ALPHA, ALPHA, ALPHA, ALPHA, ALPHA, ALPHA, ALPHA, 255, 255, 255, 255, 255, 250, ALPHA, ALPHA, ALPHA, ALPHA, ALPHA, ALPHA, ALPHA, ALPHA, ALPHA, ALPHA, ALPHA, ALPHA, ALPHA, ALPHA, ALPHA, ALPHA, ALPHA, ALPHA, 245, 255, 255, 255, 255, 255, 255, ALPHA, ALPHA, ALPHA, ALPHA, ALPHA, ALPHA, ALPHA, ALPHA, ALPHA, ALPHA, ALPHA, ALPHA, ALPHA, ALPHA, ALPHA, ALPHA, ALPHA, ALPHA, 250, 255, 255, 255, 255, 255, 255, 255, ALPHA, ALPHA, ALPHA, ALPHA, ALPHA, ALPHA, ALPHA, ALPHA, ALPHA, ALPHA, ALPHA, ALPHA, ALPHA, ALPHA, ALPHA, ALPHA, ALPHA, 250, 250, 250, 250, 255, 255, 255, 250, 250, 255, 250, ALPHA, ALPHA, ALPHA, ALPHA, ALPHA, ALPHA, ALPHA, ALPHA, ALPHA, ALPHA, ALPHA, ALPHA, ALPHA, ALPHA, ALPHA, 250, 250, 255, 255, 255, 255, 250, 255, 255, 255, ALPHA, ALPHA, ALPHA, ALPHA, ALPHA, ALPHA, ALPHA, ALPHA, ALPHA, ALPHA, ALPHA, ALPHA, ALPHA, ALPHA, 245, 250, 250, 255, 255, 255, 255, 255, 255, 255, 255, 255, ALPHA, ALPHA, ALPHA, ALPHA, ALPHA, ALPHA, ALPHA, ALPHA, ALPHA, ALPHA, ALPHA, 250, 250, 250, 255, 250, 250, 255, 255, 255, 255, 255, 255, 255, 255, ALPHA, ALPHA, ALPHA, ALPHA, ALPHA, ALPHA, ALPHA, ALPHA, ALPHA, ALPHA, 245, 250, 255, 255, 255, 255, 250, 255, 255, 255, 255, 255, 255, 255, 255, 250, 213, ALPHA, ALPHA, ALPHA, ALPHA, ALPHA, ALPHA, ALPHA, ALPHA, 250, 255, 255, 255, 255, 255, 255, 255, 255, 255, 255, 255, 255, 255, 250, 250, 255, ALPHA, ALPHA, ALPHA, ALPHA, ALPHA, ALPHA, ALPHA, ALPHA, 245, 250, 250, 255, 255, 255, 255, 250, 255, 255, 255, 255, 255, 250, 255, 255, 255, 255, 255, 250, ALPHA, ALPHA, ALPHA, 250, 250, 250, 250, 250, 250, 255, 255, 255, 250, 250, 250,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 250, 250};

const unsigned char GRASS_XY[2] PROGMEM = {96, 4};
const unsigned char GRASS[96*4] PROGMEM = {ALPHA, ALPHA, ALPHA, ALPHA, ALPHA, ALPHA, ALPHA, ALPHA, ALPHA, ALPHA, ALPHA, ALPHA, ALPHA, 48, ALPHA, ALPHA, ALPHA, ALPHA, ALPHA, ALPHA, ALPHA, ALPHA, ALPHA, ALPHA, ALPHA, ALPHA, ALPHA, ALPHA, ALPHA, 48, 44, ALPHA, ALPHA, ALPHA, ALPHA, ALPHA, ALPHA, ALPHA, ALPHA, ALPHA, ALPHA, ALPHA, ALPHA, ALPHA, ALPHA, 48, ALPHA, ALPHA, ALPHA, ALPHA, ALPHA, ALPHA, ALPHA, ALPHA, ALPHA, ALPHA, ALPHA, ALPHA, ALPHA, ALPHA, ALPHA, 48, 44, ALPHA, ALPHA, 44, 48, ALPHA, ALPHA, ALPHA, ALPHA, ALPHA, ALPHA, ALPHA, ALPHA, ALPHA, ALPHA, ALPHA, ALPHA, ALPHA, ALPHA, ALPHA, 48, ALPHA, ALPHA, ALPHA, ALPHA, ALPHA, ALPHA, ALPHA, ALPHA, ALPHA, ALPHA, ALPHA, ALPHA, ALPHA, ALPHA, 48, ALPHA, ALPHA, ALPHA, 80, 48, ALPHA, 48, 48, 0x1C, 48, 48, ALPHA, 48, ALPHA, ALPHA, 0x1C, ALPHA, 0x1C, 0x1C, ALPHA, ALPHA, ALPHA, ALPHA, 0x1C, 48, 85, 48, 48, 80, ALPHA, ALPHA, 48, ALPHA, ALPHA, ALPHA, 80, 48, ALPHA, 48, 48, 0x1C, 48, 48, ALPHA, 48, ALPHA, ALPHA, 0x1C, ALPHA, 0x1C, 0x1C, ALPHA, ALPHA, ALPHA, ALPHA, 0x1C, 48, 85, 48, 48, 80, ALPHA, ALPHA, 80, 48, 48, 85, 48, 0x1C, ALPHA, ALPHA, ALPHA, ALPHA, 0x1C, 0x1C, ALPHA, 0x1C, ALPHA, ALPHA, 48, ALPHA, 48, 48, 0x1C, 48, 48, ALPHA, 48, 80, ALPHA, ALPHA, ALPHA, 48, ALPHA, 48, 0x1C, 0x1C, 48, 48, 48, 0x1C, 48, 48, 0x1C, 49, 48, 48, 48, 0x1C, 48, ALPHA, 0x1C, ALPHA, 0x1C, 0x1C, 0x1C, 48, 0x1C, 48, 0x1C, 0x1C, 0x1C, 0x1C, 0x1C, 0x1C, 48, 48, 0x1C, 0x1C, 48, 48, 48, 0x1C, 48, 48, 0x1C, 49, 48, 48, 48, 0x1C, 48, ALPHA, 0x1C, ALPHA, 0x1C, 0x1C, 0x1C, 48, 0x1C, 48, 0x1C, 0x1C, 0x1C, 0x1C, 0x1C, 0x1C, 48, 48, 0x1C, 0x1C, 0x1C, 0x1C, 0x1C, 0x1C, 48, 0x1C, 48, 0x1C, 0x1C, 0x1C, ALPHA, 0x1C, ALPHA, 48, 0x1C, 48, 48, 48, 49, 0x1C, 48, 48, 0x1C, 48, 48,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 0x1C, 0x1C};

//############################
//###### GAME VARIABLES ######
//############################

unsigned char EXP;
unsigned char LEVEL;

//######################################
//###### FRAME and POS CONTROLELR ######
//######################################

#define NOT_ACTIVE 255
#define ACTIVE 0

//%%%%%%%%%%%%%%%%%%%
//%%%% ENVIRON %%%%%%
//%%%%%%%%%%%%%%%%%%%

#define TIME_FRAME_LEN 200
unsigned char TIME_FRAME = 0;

//-------------------
//------- TREE ------
//-------------------

#define TREE_LENGTH 5
#define N_TREE 5
unsigned char TREE_STATE[N_TREE];

void GetTreeState(unsigned char EXP){

  EXP /= 3; // Changes state every +3 exp

  // What's a little inefficiency for readability eh?
  unsigned char i;
  for (i = 0; i < N_TREE; ++i){
    TREE_STATE[i] = NOT_ACTIVE;
  }

  unsigned char FullyGrown = 0, temp = EXP;
  while (temp >= TREE_LENGTH && FullyGrown < N_TREE){
    FullyGrown += 1;
    temp -= TREE_LENGTH;
  }

  for (i = 0; i < FullyGrown; ++i){
    TREE_STATE[i] = TREE_LENGTH - 1;  
  }

  if (FullyGrown != N_TREE) TREE_STATE[FullyGrown] = EXP % TREE_LENGTH;
}

//%%%%%%%%%%%%%%%%%%%
//%%%%%% KAHO %%%%%%%
//%%%%%%%%%%%%%%%%%%%

unsigned char KAHO_POS_X = Rx/2 - 11/2;
unsigned char KAHO_POS_Y = Ry/2 - 20/2 + 13;

//-------------------
//----- RUNNING -----
//-------------------

#define KAHO_SPEED 4
#define RUN_LENGTH 8
unsigned char RUN_FRAME = NOT_ACTIVE;
bool is_run = false; // Sprite is running
bool is_left = false; // Sprite is running to the left

//-------------------
//------ IDLE -------
//-------------------

#define IDLE_LENGTH 6
unsigned char IDLE_FRAME = ACTIVE;
bool is_idle = true; // Sprite is idle

//##########################
//#### GAME SCREEN VARS ####
//##########################

void GetGameVariables(){
  EXP = GetGameVariables(0);
  LEVEL = GetGameVariables(1);
}

void UpdateFlags(){
  if (display.getButtons(TSButtonLowerLeft) || display.getButtons(TSButtonLowerRight)){
    is_run = true;
    is_left = display.getButtons(TSButtonLowerLeft);
  } else is_run = false;

  is_idle = !is_run; 
}

void UpdateFrame(unsigned char* frame, const unsigned char len){
  if (*frame == NOT_ACTIVE) *frame = ACTIVE;
  else *frame = (*frame + 1) % len;

  GetTreeState(EXP);
}

void FrameController(){
  if (is_run) UpdateFrame(&RUN_FRAME, RUN_LENGTH);
  else RUN_FRAME = NOT_ACTIVE;

  if (is_idle) UpdateFrame(&IDLE_FRAME, IDLE_LENGTH);
  else IDLE_FRAME = NOT_ACTIVE;

  TIME_FRAME = (TIME_FRAME + 1) % TIME_FRAME_LEN;
}

void SpritePosController(){
  if (is_run){
    if (is_left) KAHO_POS_X = (Rx - KAHO_SPEED + KAHO_POS_X)%Rx;
    else KAHO_POS_X = (KAHO_POS_X + KAHO_SPEED) % Rx;
  }
}

//%%%%%%%%%%%%%%%%%%%%%%%%%%%%%%%%%%
//%%%%%% GAME SETUP AND LOOP %%%%%%%
//%%%%%%%%%%%%%%%%%%%%%%%%%%%%%%%%%%

void Display_Game() {

  GetGameVariables();
  UpdateFlags();
  FrameController();
  SpritePosController();
  DrawScreen();
  
}

//%%%%%%%%%%%%%%%%%%%%%%%%%%%%%
//%%%%%% DRAWING SCREEN %%%%%%%
//%%%%%%%%%%%%%%%%%%%%%%%%%%%%%

void DrawScreen(){
  // Arrange sprite in increasing z-order
  
  // Initialise frame sizes
  unsigned char RUN_X, RUN_Y, IDLE_X, IDLE_Y, CLOUD1_X, CLOUD1_Y, GRASS_X, GRASS_Y, HAM_X, HAM_Y;
  RUN_X = pgm_read_byte_near(RUN_XY + (RUN_FRAME)*2);
  RUN_Y = pgm_read_byte_near(RUN_XY + (RUN_FRAME)*2 + 1);
  IDLE_X = pgm_read_byte_near(IDLE_XY + (IDLE_FRAME)*2);
  IDLE_Y = pgm_read_byte_near(IDLE_XY + (IDLE_FRAME)*2 + 1);

  CLOUD1_X = pgm_read_byte_near(CLOUD1_XY);
  CLOUD1_Y = pgm_read_byte_near(CLOUD1_XY + 1);
  GRASS_X = pgm_read_byte_near(GRASS_XY);
  GRASS_Y = pgm_read_byte_near(GRASS_XY + 1);

  HAM_X = pgm_read_byte_near(HAMBURGER_MENU_XY);
  HAM_Y = pgm_read_byte_near(HAMBURGER_MENU_XY + 1);

  // Sets cursor
  display.setX(0, Rx-1);
  display.setY(0, Ry-1);
  display.startData();
  
  unsigned char LINE_N, var;
  for (LINE_N = 0; LINE_N < Ry; LINE_N++){
    
    //Draw background
    for (var = 0; var < Rx; var++) LINEBUFFER[var] = BACKGROUND;

    // ----------------------
    // ---- DRAW ENVIRON ----
    // ----------------------

    //Draw Clouds
    DrawSprite(CLOUD1, CLOUD1_X, CLOUD1_Y,
              0, 0, 0,
              (unsigned char)(2*Rx*((float)(TIME_FRAME_LEN-TIME_FRAME)/TIME_FRAME_LEN)), 15, 
              false,
              LINE_N);
              
    DrawSprite(CLOUD1, CLOUD1_X, CLOUD1_Y, 
               0, 0, 0, 
               (unsigned char)(Rx*((float)(TIME_FRAME_LEN-TIME_FRAME)/TIME_FRAME_LEN) + 50), 25, 
               false,
               LINE_N);

    //Draw Trees
    unsigned char i, frame;
    for (i = 0; i < N_TREE; ++i){
      frame = TREE_STATE[i];
      if (frame != NOT_ACTIVE){
        DrawSprite(TREE_ARR[frame], pgm_read_byte_near(TREE_XY + (frame)*2), pgm_read_byte_near(TREE_XY + (frame)*2 + 1), 
                   pgm_read_byte_near(TREE_disp + (frame)*2), pgm_read_byte_near(TREE_disp + (frame)*2 + 1),
                   0,
                   Rx/2 + i*155, Ry - 15, // 155 because 155 ~ Rx * \phi, the golden ratio. This makes the trees look random
                   false,
                   LINE_N);
      } else break;
    }
    
    //Draw Ground
    if (LINE_N > Ry - 12) for (var = 0; var < Rx; var++) LINEBUFFER[var] = GROUND;
    DrawSprite(GRASS, GRASS_X, GRASS_Y, 
               0, 0, 0,
               Rx/2 + (int)(.7*sin(TIME_FRAME*0.2 + 0.3) + .7), Ry-13, // A touch of shake
               false, 
               LINE_N);


    // -------------------
    // ---- DRAW KAHO ----
    // -------------------
    
    //Draw RUN
    if (RUN_FRAME != NOT_ACTIVE) DrawSprite(RUN_ARR[RUN_FRAME], RUN_X, RUN_Y,
                                            pgm_read_byte_near(RUN_disp + (RUN_FRAME)*2), pgm_read_byte_near(RUN_disp + (RUN_FRAME)*2 + 1),
                                            pgm_read_byte_near(RUN_disp2 + RUN_FRAME),
                                            KAHO_POS_X, KAHO_POS_Y + 2,
                                            is_left, 
                                            LINE_N);
    //Draw idle
    if (IDLE_FRAME != NOT_ACTIVE) DrawSprite(IDLE_ARR[IDLE_FRAME], IDLE_X, IDLE_Y,
                                            pgm_read_byte_near(IDLE_disp + (IDLE_FRAME)*2), pgm_read_byte_near(IDLE_disp + (IDLE_FRAME)*2 + 1),
                                            pgm_read_byte_near(IDLE_disp2 + IDLE_FRAME),
                                            KAHO_POS_X, KAHO_POS_Y,
                                            is_left, 
                                            LINE_N);

    // ----------------
    // --- OVERLAYS ---
    // ----------------

    //if (LINE_N < 6+11 && LINE_N > 6) for (var = 4; var < 14; var++) LINEBUFFER[var] = 183;
    
    //Draw hamburger menu
    DrawSprite(HAMBURGER_MENU, HAM_X, HAM_Y,
              5, 10,
              0, 0, 0,
              false, 
              LINE_N);

    display.writeBuffer(LINEBUFFER, Rx);
  }
  display.endTransfer();
}

void DrawSprite(long SpritePointer, unsigned char SpriteSize_X,  unsigned char SpriteSize_Y,
                char disp_x, char disp_y,
                char disp_x2,
                int x, int y,
                bool reflect, 
                unsigned char line_n){
                  
  // SpritePointer is the pointer to the bitmap data (in progmem)
  // SpriteSize_X is the x-size of the bitmap
  // SpriteSize_Y is the y-size of the bitmap
  // disp_x and disp_y is the displacement upon cropping (to the left and down)
  // disp_x2 is the displacement upon cropping to the right (used when reflect is given)
  // x is the position to plot (left side coord)
  // y is the position to plot (bottom side coord)
  // reflect is whether to reflect along y axis

  y += disp_y;
  if (!reflect) x += disp_x;
  else x += disp_x2 + disp_x;

  if (line_n < y || line_n >= y + SpriteSize_Y){return;}
  
  int pos, pixel;
  for (pos = x; pos < x + SpriteSize_X; pos++){
    pixel = pgm_read_byte_near(SpritePointer + SpriteSize_X*(line_n - y) + pos - x);
    
    if (pixel != ALPHA){
      
      // (Rx - 1 - pos) is to fix a very specific bufferoverflow that occurs when
      // Kaho is standing on a very specific pixel
      // Facing left
      // On a very specific sprite frame
      
      if (reflect) LINEBUFFER[(2*x + SpriteSize_X + (Rx - 1 - pos))%Rx] = pixel;
      else LINEBUFFER[pos%Rx] = pixel;
    }
  }
}
